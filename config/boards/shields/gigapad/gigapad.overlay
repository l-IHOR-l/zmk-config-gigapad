/ {
    chosen {
        zmk,kscan = &default_kscan;
    };

    default_kscan: kscan {
        compatible = "zmk,kscan-gpio-direct";
        label = "default_kscan";

        input-gpios =
            <&xiao_d 17 (GPIO_ACTIVE_HIGH | GPIO_PULL_UP)>,
            <&xiao_d 20 (GPIO_ACTIVE_HIGH | GPIO_PULL_UP)>,
            <&xiao_d 22 (GPIO_ACTIVE_HIGH | GPIO_PULL_UP)>,
            <&xiao_d 24 (GPIO_ACTIVE_HIGH | GPIO_PULL_UP)>;
    };
};
